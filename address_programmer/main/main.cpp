#include "freertos/FreeRTOS.h"
#include "freertos/task.h"
#include "esp_log.h"
#include "nvs_flash.h"

#include "i2c.h"
#include "als31300.h"
#include "target_address.h"  // Generated by batch file

static const char* TAG = "PROGRAMMER";

extern "C" void app_main() {
    ESP_LOGI(TAG, "");
    ESP_LOGI(TAG, "========================================");
    ESP_LOGI(TAG, "   ALS31300 Hall Sensor Address Programmer");
    ESP_LOGI(TAG, "========================================");
    ESP_LOGI(TAG, "");
    ESP_LOGI(TAG, "Target address: 0x%02X (Sensor #%d)", TARGET_ADDRESS, TARGET_ADDRESS - 0x60);
    ESP_LOGI(TAG, "");

    // Initialize NVS
    esp_err_t ret = nvs_flash_init();
    if (ret == ESP_ERR_NVS_NO_FREE_PAGES || ret == ESP_ERR_NVS_NEW_VERSION_FOUND) {
        ESP_ERROR_CHECK(nvs_flash_erase());
        ret = nvs_flash_init();
    }
    ESP_ERROR_CHECK(ret);

    // Initialize I2C
    I2C::init();
    vTaskDelay(pdMS_TO_TICKS(500));

    // Scan for sensors
    ESP_LOGI(TAG, "Scanning I2C bus for ALS31300 sensors...");
    ESP_LOGI(TAG, "");

    uint8_t foundAddress = 0;
    int sensorsFound = 0;

    for (uint8_t addr = 0x60; addr <= 0x67; addr++) {
        if (I2C::devicePresent(addr)) {
            ESP_LOGI(TAG, "  Found sensor at 0x%02X (Sensor #%d)", addr, addr - 0x60);
            foundAddress = addr;
            sensorsFound++;
        }
    }

    // Also check default factory address (0x60)
    if (sensorsFound == 0 && I2C::devicePresent(0x60)) {
        ESP_LOGI(TAG, "  Found sensor at 0x60 (factory default)");
        foundAddress = 0x60;
        sensorsFound = 1;
    }

    ESP_LOGI(TAG, "");
    ESP_LOGI(TAG, "Scan complete. Found %d sensor(s).", sensorsFound);
    ESP_LOGI(TAG, "");

    if (sensorsFound == 0) {
        ESP_LOGE(TAG, "ERROR: No sensors found!");
        ESP_LOGE(TAG, "Check wiring:");
        ESP_LOGE(TAG, "  - SDA -> GPIO 21");
        ESP_LOGE(TAG, "  - SCL -> GPIO 22");
        ESP_LOGE(TAG, "  - VCC -> 3.3V");
        ESP_LOGE(TAG, "  - GND -> GND");
        ESP_LOGI(TAG, "");
        ESP_LOGI(TAG, "========================================");
        ESP_LOGE(TAG, "   PROGRAMMING FAILED - NO SENSOR");
        ESP_LOGI(TAG, "========================================");
        return;
    }

    if (sensorsFound > 1) {
        ESP_LOGE(TAG, "ERROR: Multiple sensors found!");
        ESP_LOGE(TAG, "Disconnect all but ONE sensor and try again.");
        ESP_LOGI(TAG, "");
        ESP_LOGI(TAG, "========================================");
        ESP_LOGE(TAG, "   PROGRAMMING FAILED - TOO MANY SENSORS");
        ESP_LOGI(TAG, "========================================");
        return;
    }

    if (foundAddress == TARGET_ADDRESS) {
        ESP_LOGI(TAG, "Sensor is already at target address 0x%02X", TARGET_ADDRESS);
        ESP_LOGI(TAG, "No programming needed!");
        ESP_LOGI(TAG, "");
        ESP_LOGI(TAG, "========================================");
        ESP_LOGI(TAG, "   SUCCESS - ALREADY CONFIGURED");
        ESP_LOGI(TAG, "========================================");
        return;
    }

    // Program the new address
    ESP_LOGI(TAG, "Programming sensor from 0x%02X to 0x%02X...", foundAddress, TARGET_ADDRESS);
    ESP_LOGI(TAG, "");

    if (ALS31300::programAddress(foundAddress, TARGET_ADDRESS)) {
        ESP_LOGI(TAG, "");
        ESP_LOGI(TAG, "========================================");
        ESP_LOGI(TAG, "   SUCCESS!");
        ESP_LOGI(TAG, "========================================");
        ESP_LOGI(TAG, "");
        ESP_LOGI(TAG, "Sensor programmed to address 0x%02X (Sensor #%d)", TARGET_ADDRESS, TARGET_ADDRESS - 0x60);
        ESP_LOGI(TAG, "");
        ESP_LOGI(TAG, ">>> POWER CYCLE THE SENSOR NOW <<<");
        ESP_LOGI(TAG, "");
        ESP_LOGI(TAG, "Disconnect and reconnect the sensor's power");
        ESP_LOGI(TAG, "to apply the new address.");
    } else {
        ESP_LOGI(TAG, "");
        ESP_LOGI(TAG, "========================================");
        ESP_LOGE(TAG, "   PROGRAMMING FAILED");
        ESP_LOGI(TAG, "========================================");
        ESP_LOGI(TAG, "");
        ESP_LOGE(TAG, "Could not program sensor. Check connections and try again.");
    }
}
